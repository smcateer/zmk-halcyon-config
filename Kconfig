## Kconfig
```kconfig
config ZMK_BEHAVIOR_KYRIA_BATTERY
    bool "Type Kyria split battery status"
    default y
    depends on DT_HAS_ZMK_BEHAVIOR_KYRIA_BATTERY_ENABLED
    depends on ZMK_SPLIT_ROLE_CENTRAL && ZMK_SPLIT_BLE_CENTRAL_BATTERY_LEVEL_FETCHING
    help
      Types the live left/right coin-cell battery levels into the focused application.

config ZMK_BEHAVIOR_KYRIA_ENCODER
    bool "Kyria encoder mode controller"
    default y
    depends on DT_HAS_ZMK_BEHAVIOR_KYRIA_ENCODER_MODE_ENABLED
    depends on DT_HAS_ZMK_BEHAVIOR_KYRIA_ENCODER_ACTION_ENABLED
    depends on ZMK_SPLIT_ROLE_CENTRAL
    help
      Dynamic encoder dispatch according to held modes and the ordinary
      keyboard layer, without encoder-specific layers.
```

## dts/bindings/zmk,behavior-kyria-battery.yaml
```yaml
description: Types both Kyria split battery levels as ASCII bars

compatible: "zmk,behavior-kyria-battery"

include: zero_param.yaml
```

## dts/bindings/zmk,behavior-kyria-encoder-action.yaml
```yaml
description: Kyria dynamic encoder rotation dispatcher
compatible: "zmk,behavior-kyria-encoder-action"
properties:
  "#binding-cells":
    type: int
    const: 1
    required: true
  key-press:
    type: phandle
    required: true
  mouse-scroll:
    type: phandle
    required: true
  nav-layer:
    type: int
    required: true
  base-scroll:
    type: int
    required: true
  fast-multiplier:
    type: int
    required: true
binding-cells:
  - rotation
```

## dts/bindings/zmk,behavior-kyria-encoder-mode.yaml
```yaml
description: Kyria encoder mode selector, independent of keyboard layers
compatible: "zmk,behavior-kyria-encoder-mode"
properties:
  display-name:
    type: string
  "#binding-cells":
    type: int
    const: 1
    required: true
binding-cells:
  - mode
```
